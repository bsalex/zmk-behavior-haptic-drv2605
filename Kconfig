## Kconfig
```kconfig
menu "Haptic DRV2605 Options"

config ZMK_BEHAVIOR_HAPTIC_DRV2605
    bool "Haptic DRV2605 Behavior"
	default n


endmenu

module = ZMK_BEHAVIOR_HAPTIC_DRV2605
module-str = zmk_behavior_haptic_drv2605
source "subsys/logging/Kconfig.template.log_config"
```

## dts/bindings/behaviors/zmk,behavior-haptic-drv2605.yaml
```yaml
description: Haptic feedback behavior using DRV2605

compatible: "zmk,behavior-haptic-drv2605"

include: one_param.yaml

properties:
    haptic-device:
        type: phandle
        required: false
        description: "The DRV2605 haptic device to control (Deprecated: Auto-discovered)"
    
    driver-index:
        type: int
        default: 0
        description: "Index of the DRV2605 instance to use (0 = first found, 1 = second...)"
```

## dts/bindings/mocks/zmk,i2c-mock.yaml
```yaml
description: Mock I2C Controller

compatible: "zmk,i2c-mock"

include: i2c-controller.yaml

properties:
    "#address-cells":
        required: true
        const: 1
    "#size-cells":
        required: true
        const: 0
```

## dts/bindings/output-haptic.yaml
```yaml
# Copyright (c) 2024 The ZMK Contributors
# SPDX-License-Identifier: MIT

description: |
  Value-to-haptic-feedback output device

compatible: "zmk,output-haptic"

properties:
  device:
    type: phandle
    required: true
  driver:
    type: string
    required: false
```

## dts/bindings/zmk,haptic-output-proxy.yaml
```yaml
# Copyright (c) 2024 The ZMK Contributors
# SPDX-License-Identifier: MIT

description: |
  Haptic driver that proxies commands to a generic output device

compatible: "zmk,haptic-output-proxy"



properties:
  output-device:
    type: phandle
    required: false
```
